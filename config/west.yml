## config/west.yml
```yaml
manifest:
  remotes:
    - name: zmkfirmware
      url-base: https://github.com/zmkfirmware
    - name: hitsmaxft
      url-base: https://github.com/hitsmaxft
    - name: englmaxi
      url-base: https://github.com/englmaxi
    - name: urob
      url-base: https://github.com/urob
    - name: janpfischer
      url-base: https://github.com/janpfischer
    - name: zzeneg
      url-base: https://github.com/zzeneg
    - name: srwi
      url-base: https://github.com/srwi

  projects:
    - name: zmk
      remote: zmkfirmware
      revision: main
      clone-depth: 1
      import:
        file: app/west.yml

    - name: zmk-helpers
      remote: urob
      revision: main
      clone-depth: 1

    #- name: zmk-rgbled-widget
    #  remote: hitsmaxft
    #  revision: main
    #  clone-depth: 1

    - name: zmk-dongle-display
      remote: englmaxi
      revision: main
      clone-depth: 1

    #- name: zmk-dongle-screen
    #  remote: janpfischer
    #  revision: main
    #  clone-depth: 1

    - name: zmk-raw-hid
      remote: zzeneg
      revision: main

    - name: zmk-keypeek-layer-notifier
      remote: srwi
      revision: master
      
  self:
    path: config
```
